// SPDX-License-Identifier: GPL-2.0-or-later
/*
 * Device Tree Overlay for GPIO LED Driver (LED Class)
 *
 * This overlay creates a GPIO-based LED device that uses the standard
 * Linux LED class subsystem. The LED will appear in /sys/class/leds/
 * and can be controlled via sysfs or use LED triggers.
 */

/dts-v1/;
/plugin/;

/ {
	compatible = "brcm,bcm2711", "brcm,bcm2837", "brcm,bcm2835";

	/* Configure GPIO pin for LED */
	fragment@0 {
		target = <&gpio>;
		__overlay__ {
			led_pins: led_pins {
				brcm,pins = <20>;           /* GPIO 20 */
				brcm,function = <1>;        /* Output */
				brcm,pull = <0>;            /* No pull up/down */
			};
		};
	};

	/* Create LED device */
	fragment@1 {
		target-path = "/";
		__overlay__ {
			gpio_led: gpio_led {
				compatible = "custom,gpio-led";
				pinctrl-names = "default";
				pinctrl-0 = <&led_pins>;
				gpios = <&gpio 20 0>;               /* GPIO20, Active High (flag=0) */
				label = "gpio-led";                 /* Name in /sys/class/leds/ */
				linux,default-trigger = "none";     /* No automatic trigger */
				default-state = "off";              /* Start with LED off */
				status = "okay";
			};
		};
	};

	/* Runtime parameters (can be overridden at boot) */
	__overrides__ {
		/* Change GPIO pin: dtoverlay=leds-gpio-custom,gpio=20 */
		gpio = <&gpio_led>, "gpios:4",
		       <&led_pins>, "brcm,pins:0";
		
		/* Change LED label: dtoverlay=leds-gpio-custom,label=status-led */
		label = <&gpio_led>, "label";
		
		/* Change trigger: dtoverlay=leds-gpio-custom,trigger=heartbeat */
		trigger = <&gpio_led>, "linux,default-trigger";
		
		/* Retain state on suspend: dtoverlay=leds-gpio-custom,retain_state */
		retain_state = <&gpio_led>, "retain-state-suspended?";
	};
};
