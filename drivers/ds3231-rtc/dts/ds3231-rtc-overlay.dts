// SPDX-License-Identifier: GPL-2.0-or-later
/*
 * Device Tree Overlay — DS3231 RTC on Raspberry Pi I2C1
 *
 * Wiring (DS3231 module → Raspberry Pi 40-pin header):
 *   VCC  → 3.3 V  (pin 1 or 17)
 *   GND  → GND    (pin 6, 9, 14, 20, 25, 30, 34, or 39)
 *   SDA  → GPIO2  (pin 3)  — I2C1 data
 *   SCL  → GPIO3  (pin 5)  — I2C1 clock
 *   SQW  → not connected   (alarm IRQ — Phase 2)
 *   32K  → not connected
 *
 * Installation:
 *   1. Copy ds3231-rtc.dtbo to /boot/overlays/
 *   2. Add to /boot/config.txt:
 *        dtparam=i2c_arm=on
 *        dtoverlay=ds3231-rtc
 *   3. Reboot
 *
 * Compatible boards: Raspberry Pi 4B, 3B+, Zero 2 W
 */

/dts-v1/;
/plugin/;

/ {
	compatible = "brcm,bcm2711", "brcm,bcm2837", "brcm,bcm2835";

	/*
	 * Fragment 0: Configure I2C1 bus for DS3231
	 *
	 * - Enable the bus (status = "okay")
	 * - Set Fast Mode 400 kHz (DS3231 supports up to 400 kHz)
	 * - Declare a child node for the DS3231 at slave address 0x68
	 */
	fragment@0 {
		target = <&i2c1>;
		__overlay__ {
			status = "okay";
			clock-frequency = <400000>;
			#address-cells = <1>;
			#size-cells = <0>;

			ds3231: ds3231@68 {
				compatible = "maxim,ds3231";
				reg = <0x68>;
				wakeup-source;  /* Enable alarm wakeup (Phase 2) */
			};
		};
	};
};
