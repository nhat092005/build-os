// SPDX-License-Identifier: GPL-2.0-or-later
/*
 * Device Tree Overlay for GPIO Rust Driver
 *
 * This overlay configures a GPIO pin for the Rust-based GPIO driver.
 * The driver uses the legacy GPIO API (gpio_request/gpio_free) wrapped
 * in a safe Rust abstraction layer.
 */

/dts-v1/;
/plugin/;

/ {
	compatible = "brcm,bcm2711", "brcm,bcm2837", "brcm,bcm2835";

	/* Configure GPIO pin */
	fragment@0 {
		target = <&gpio>;
		__overlay__ {
			gpio_rust_pins: gpio_rust_pins {
				brcm,pins = <16>;			/* GPIO 16 */
				brcm,function = <1>;		/* Output */
				brcm,pull = <0>;			/* No pull up/down */
			};
		};
	};

	/*
	 * Documentation node — no platform_driver binds here.
	 * The gpio-rust driver uses the legacy integer GPIO API
	 * (gpio_request/gpio_free) because Rust bindings for
	 * devm_gpiod_get() are not available in kernel 6.12.
	 * The actual GPIO number is communicated via module_param;
	 * this node exists only to anchor the pinctrl configuration.
	 */
	fragment@1 {
		target-path = "/";
		__overlay__ {
			gpio_rust: gpio-rust {
				compatible = "gpio-rust";
				pinctrl-names = "default";
				pinctrl-0 = <&gpio_rust_pins>;
				status = "okay";
			};
		};
	};
};
