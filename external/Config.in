## external/configs/raspberrypi4_64_custom_defconfig
```kconfig
# Raspberry Pi 4 64-bit Custom Defconfig for Buildroot

# Architecture and CPU
BR2_aarch64=y
BR2_cortex_a72=y
BR2_ARM_FPU_VFPV4=y

# Toolchain - Using Local Pre-installed Toolchain
BR2_TOOLCHAIN_EXTERNAL=y
BR2_TOOLCHAIN_EXTERNAL_PREINSTALLED=y
BR2_TOOLCHAIN_EXTERNAL_CUSTOM=y
BR2_TOOLCHAIN_EXTERNAL_PATH="$(BR2_EXTERNAL_NHAT092005_PATH)/../toolchains/aarch64-buildroot-linux-gnu_sdk-buildroot"
BR2_TOOLCHAIN_EXTERNAL_CUSTOM_PREFIX="aarch64-linux"
BR2_TOOLCHAIN_EXTERNAL_GCC_14=y
BR2_TOOLCHAIN_EXTERNAL_HEADERS_5_4=y
BR2_TOOLCHAIN_EXTERNAL_CUSTOM_GLIBC=y
BR2_TOOLCHAIN_EXTERNAL_CXX=y
BR2_TOOLCHAIN_EXTERNAL_OPENMP=y
BR2_TOOLCHAIN_EXTERNAL_HAS_SSP=y
BR2_TOOLCHAIN_EXTERNAL_HAS_SSP_STRONG=y
# BR2_TOOLCHAIN_EXTERNAL_INET_RPC is not set

# Linux Kernel
BR2_LINUX_KERNEL=y
BR2_LINUX_KERNEL_LATEST_VERSION=y
BR2_LINUX_KERNEL_DEFCONFIG="bcm2711"
BR2_LINUX_KERNEL_DTS_SUPPORT=y
BR2_LINUX_KERNEL_INTREE_DTS_NAME="broadcom/bcm2711-rpi-4-b broadcom/bcm2711-rpi-400 broadcom/bcm2711-rpi-cm4 broadcom/bcm2711-rpi-cm4s"
BR2_LINUX_KERNEL_NEEDS_HOST_OPENSSL=y

# Firmware and Bootloader
BR2_PACKAGE_RPI_FIRMWARE=y
BR2_PACKAGE_RPI_FIRMWARE_VARIANT_PI4=y
BR2_PACKAGE_RPI_FIRMWARE_CONFIG_FILE="$(BR2_EXTERNAL_NHAT092005_PATH)/board/raspberrypi/config.txt"

# Basic Packages
BR2_PACKAGE_BUSYBOX_SHOW_OTHERS=y
BR2_PACKAGE_XZ=y
BR2_PACKAGE_KMOD=y
BR2_PACKAGE_KMOD_TOOLS=y

# WiFi and Networking Packages for Raspberry Pi 4
BR2_PACKAGE_BRCMFMAC_SDIO_FIRMWARE_RPI=y
BR2_PACKAGE_BRCMFMAC_SDIO_FIRMWARE_RPI_BT=y
BR2_PACKAGE_BRCMFMAC_SDIO_FIRMWARE_RPI_WIFI=y
BR2_PACKAGE_WIRELESS_REGDB=y
BR2_PACKAGE_IW=y
BR2_PACKAGE_WPA_SUPPLICANT=y
BR2_PACKAGE_WPA_SUPPLICANT_NL80211=y
BR2_PACKAGE_WPA_SUPPLICANT_CLI=y
BR2_PACKAGE_WPA_SUPPLICANT_PASSPHRASE=y

# OpenSSH Packages
BR2_PACKAGE_OPENSSH=y
BR2_PACKAGE_OPENSSH_CLIENT=y
BR2_PACKAGE_OPENSSH_SERVER=y
BR2_PACKAGE_OPENSSH_KEY_UTILS=y

# Root Filesystem Settings
BR2_TARGET_ROOTFS_EXT2=y
BR2_TARGET_ROOTFS_EXT2_4=y
BR2_TARGET_ROOTFS_EXT2_SIZE="120M"
# BR2_TARGET_ROOTFS_TAR is not set

# Host Utilities
BR2_PACKAGE_HOST_DOSFSTOOLS=y
BR2_PACKAGE_HOST_GENIMAGE=y
BR2_PACKAGE_HOST_KMOD_XZ=y
BR2_PACKAGE_HOST_MTOOLS=y

# Custom Settings
BR2_DOWNLOAD_FORCE_CHECK_HASHES=y
BR2_SYSTEM_DHCP="eth0"
BR2_ROOTFS_POST_BUILD_SCRIPT="$(BR2_EXTERNAL_NHAT092005_PATH)/board/raspberrypi/post-build.sh"
BR2_ROOTFS_POST_FAKEROOT_SCRIPT="$(BR2_EXTERNAL_NHAT092005_PATH)/board/raspberrypi/post-fakeroot.sh"
BR2_ROOTFS_POST_IMAGE_SCRIPT="$(BR2_EXTERNAL_NHAT092005_PATH)/board/raspberrypi/post-image.sh"
BR2_ROOTFS_OVERLAY="$(BR2_EXTERNAL_NHAT092005_PATH)/board/raspberrypi/rootfs-overlay"

# Custom Driver Package
BR2_PACKAGE_GPIO_CHARDEV_DRIVER=y
BR2_PACKAGE_GPIO_LEDS_DRIVER=y
```

## external/package/Config.in
```kconfig
source "$BR2_EXTERNAL_NHAT092005_PATH/package/gpio-chardev-driver/Config.in"
source "$BR2_EXTERNAL_NHAT092005_PATH/package/gpio-leds-driver/Config.in"
source "$BR2_EXTERNAL_NHAT092005_PATH/package/gpio-rust-driver/Config.in"
source "$BR2_EXTERNAL_NHAT092005_PATH/package/gpio-sysfs-driver/Config.in"
source "$BR2_EXTERNAL_NHAT092005_PATH/package/gpio-inputs-driver/Config.in"

source "$BR2_EXTERNAL_NHAT092005_PATH/package/bh1750-driver/Config.in"
source "$BR2_EXTERNAL_NHAT092005_PATH/package/ds3231-rtc-driver/Config.in"
source "$BR2_EXTERNAL_NHAT092005_PATH/package/sht3x-driver/Config.in"

source "$BR2_EXTERNAL_NHAT092005_PATH/package/stm32-uart-driver/Config.in"
source "$BR2_EXTERNAL_NHAT092005_PATH/package/esp32-uart-driver/Config.in"
```

## external/package/bh1750-driver/Config.in
```kconfig
config BR2_PACKAGE_BH1750_DRIVER
	bool "bh1750-driver"
	depends on BR2_LINUX_KERNEL
	help
	  I2C ambient light sensor driver for the BH1750.
	  Registers as an Industrial I/O (IIO) light sensor device.
```

## external/package/ds3231-rtc-driver/Config.in
```kconfig
config BR2_PACKAGE_DS3231_RTC_DRIVER
	bool "ds3231-rtc-driver"
	depends on BR2_LINUX_KERNEL
	help
	  I2C client driver for the Maxim DS3231 RTC/TCXO.
	  Registers as a standard Linux RTC device (/dev/rtcN).
```

## external/package/esp32-uart-driver/Config.in
```kconfig
config BR2_PACKAGE_ESP32_UART_DRIVER
	bool "esp32-uart-driver"
	depends on BR2_LINUX_KERNEL
	help
	  Userspace UART transport and protocol library for communicating
	  with an external ESP32 running custom firmware (ESP-IDF).
	  The driver uses a binary frame protocol over /dev/ttyAMA*
	  and provides timeout, retry and CRC16 support.
```

## external/package/gpio-chardev-driver/Config.in
```kconfig
config BR2_PACKAGE_GPIO_CHARDEV_DRIVER
	bool "gpio-chardev-driver"
	depends on BR2_LINUX_KERNEL
	help
	  GPIO Character Device kernel driver for controlling GPIO via character device interface. 
```

## external/package/gpio-inputs-driver/Config.in
```kconfig
config BR2_PACKAGE_GPIO_INPUTS_DRIVER
	bool "gpio-inputs-driver"
	depends on BR2_LINUX_KERNEL
	help
		GPIO input driver using the Linux input subsystem.
```

## external/package/gpio-led-driver/Config.in
```kconfig
config BR2_PACKAGE_GPIO_LED_DRIVER
	bool "gpio-led-driver"
	depends on BR2_LINUX_KERNEL
	help
	  GPIO LED kernel driver for controlling LEDs via character device interface.
	  
	  This is an out-of-tree kernel module that provides /dev/gpio_led interface
	  for userspace LED control. Supports Device Tree integration.
```

## external/package/gpio-leds-driver/Config.in
```kconfig
config BR2_PACKAGE_GPIO_LEDS_DRIVER
	bool "gpio-leds-driver"
	depends on BR2_LINUX_KERNEL
	help
	  Production-ready LED class driver using standard Linux LED subsystem.
```

## external/package/gpio-rust-driver/Config.in
```kconfig
config BR2_PACKAGE_GPIO_RUST_DRIVER
	bool "gpio-rust-driver"
	depends on BR2_LINUX_KERNEL
	help
	  Safe GPIO driver written in Rust. Demonstrates upstream
	  kernel Rust driver patterns with automatic resource management
	  via Rust's ownership system and Drop trait.
```

## external/package/gpio-sysfs-driver/Config.in
```kconfig
config BR2_PACKAGE_GPIO_SYSFS_DRIVER:
    bool "gpio-sysfs-driver"
	depends on BR2_LINUX_KERNEL
	help	
	  GPIO Sysfs driver for controlling GPIO via /sys/class/gpio.
```

## external/package/leds-gpio-custom-driver/Config.in
```kconfig
config BR2_PACKAGE_LEDS_GPIO_CUSTOM_DRIVER
	bool "leds-gpio-custom-driver"
	depends on BR2_LINUX_KERNEL
	help
	  Production-ready LED class driver using standard Linux LED subsystem.
```

## external/package/sht3x-driver/Config.in
```kconfig
config BR2_PACKAGE_SHT3X_DRIVER
	bool "sht3x-driver"
	depends on BR2_LINUX_KERNEL
	help
	  Kernel driver for the Sensirion SHT3x temperature and humidity
	  sensor over I2C. The driver exposes measurements via the
	  standard Linux hwmon interface.
```

## external/package/stm32-uart-driver/Config.in
```kconfig
config BR2_PACKAGE_STM32_UART_DRIVER
	bool "stm32-uart-driver"
	depends on BR2_LINUX_KERNEL
	help
	  Userspace UART transport and protocol library for communicating
	  with an external STM32 running firmware (STM32CubeIDE).
	  The driver uses a binary frame protocol over /dev/ttyAMA*
	  and provides timeout, retry and CRC16 support.
```
